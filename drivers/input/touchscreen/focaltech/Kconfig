## drivers/input/touchscreen/focaltech/Kconfig
```kconfig
#
# Focaltech FT6x36 touchscreen driver configuration
#

if TOUCHSCREEN_FOCALTECH

config TOUCHSCREEN_FTS
	tristate "Focaltech ft6x36 core driver module"
	default y
	help
	  Say Y here to enable basic touch reporting functionalities.

	  If unsure, say N.

	  To compile this driver as a module, choose M here: the
	  module will be called synaptics_dsx_core.

config TOUCHSCREEN_FTS_EX_FUN
	tristate "Focaltech ft6x36 core driver module"
	default y
	help
	  Say Y here to enable basic touch reporting functionalities.

	  If unsure, say N.

	  To compile this driver as a module, choose M here: the
	  module will be called synaptics_dsx_core.

config TOUCHSCREEN_FTS_CTL
	tristate "Focaltech ft6x36 core driver module"
	default y
	help
	  Say Y here to enable basic touch reporting functionalities.

	  If unsure, say N.

	  To compile this driver as a module, choose M here: the
	  module will be called synaptics_dsx_core.

config TOUCHSCREEN_FTS_FLASH
        tristate "Focaltech ft6x36 core driver module"
	default y
	help
	  Say Y here to enable basic touch reporting functionalities.

	  If unsure, say N.

	  To compile this driver as a module, choose M here: the
	  module will be called synaptics_dsx_core.

config TOUCHSCREEN_FTS_GESTURE
    tristate "Focaltech ft6x36 core driver module"
	default y
	help
	  Say Y here to enable basic touch reporting functionalities.

	  If unsure, say N.

	  To compile this driver as a module, choose M here: the
	  module will be called synaptics_dsx_core.
endif
```

## drivers/input/touchscreen/focaltech_touch/Kconfig
```kconfig
#
# Focaltech Touchscreen driver configuration
#

config TOUCHSCREEN_FTS_FT3427
	bool "Focaltech Touchscreen IC FT3427"
		depends on I2C
		default n
		help
		  Say Y here if you have Focaltech touch FT3427 panel.
		  If unsure, say N.
config TOUCHSCREEN_FTS_FT8006
	bool "Focaltech Touchscreen IC FT8006"
		depends on I2C
		default n
		help
		  Say Y here if you have Focaltech touch FT8006 panel.
		  If unsure, say N.
config TOUCHSCREEN_FTS_FT6336G
	bool "Focaltech Touchscreen IC FT6336G"
		depends on I2C
		default n
		help
		  Say Y here if you have Focaltech touch FT6336G panel.
		  If unsure, say N.

config TOUCHSCREEN_FTS_FT5526
	bool "Focaltech Touchscreen IC FT5526"
		depends on I2C
		default n
		help
		  Say Y here if you have Focaltech touch FT5526 panel.
		  If unsure, say N.

config FTS_PSENSOR_ENABLE
	bool "Focaltech Touchscreen enable Proximity sensor"
		depends on I2C
		default n
		help
		  Say Y here if you enable Proximity sensor.
		  If unsure, say N.
config TOUCHSCREEN_FTS_DIRECTORY
	string "Focaltech ts directory name"
	default "focaltech_touch"
	depends on TOUCHSCREEN_FTS
```

## drivers/slic/Kconfig
```kconfig
config SLIC
	tristate "slic driver module support"
	default n

config SLIC_DEBUG
	bool "ProSLIC debug support"
	depends on SLIC
	default n

config PROSLIC
	bool "ProSLIC devices support"
	depends on SLIC && SPI
	default n

config PROSLIC_SI3217X
	tristate "ProSLIC Si3217x support"
	select PROSLIC
	default n

config PROSLIC_SI3210
	tristate "ProSLIC Si3210 support"
	select PROSLIC
	default n

config PROSLIC_RST_LOW
	bool "ProSLIC RST is active low"
	depends on PROSLIC
	default n

config SLIC_POLL_DTMF
	bool "Polling to detect DTMF"
	depends on SLIC
	default n

config SLIC_IRQ_TRIG_LOW
	bool "INT Low level trigger irq"
	depends on SLIC
	default n

config SLIC_IRQ_POLL
	bool "Polling to correct irq fault"
	depends on SLIC
	default n
```

## drivers/video/msm/Kconfig
```kconfig
source "drivers/video/msm/ba/Kconfig"
source "drivers/video/msm/msm_dba/Kconfig"

if FB_MSM
config FB_MSM_MDSS_COMMON
	bool

choice
	prompt "MDP HW version"
	default FB_MSM_MDP

config FB_MSM_MDP
	bool "MDP HW"
	---help---
	  Support for MSM MDP HW revision 2.2
	  Say Y here if this is msm7201 variant platform.

config FB_MSM_MDSS
	bool "MDSS HW"
	select SYNC
	select SW_SYNC
	select FB_MSM_MDSS_COMMON
	---help---
	The Mobile Display Sub System (MDSS) driver supports devices which
	contain MDSS hardware block.

	The MDSS driver implements frame buffer interface to provide access to
	the display hardware and provide a way for users to display graphics
	on connected display panels.

config FB_MSM_MDP_NONE
	bool "MDP HW None"
	---help---
	  Say Y here if this is mdm platform.

endchoice

config FB_MSM_QPIC
	bool
	select FB_MSM_MDSS_COMMON

config FB_MSM_QPIC_ILI_QVGA_PANEL
	bool "Qpic MIPI ILI QVGA Panel"
	select FB_MSM_QPIC
	---help---
	  Support for MIPI ILI QVGA (240x320) panel
	  ILI TECHNOLOGY 9341
	  with on-chip full display RAM
	  use parallel interface

config FB_MSM_QPIC_PANEL_DETECT
	bool "Qpic Panel Detect"
	select FB_MSM_QPIC_ILI_QVGA_PANEL
	---help---
	  Support for Qpic panel auto detect

if FB_MSM_MDSS
	source "drivers/video/msm/mdss/Kconfig"
endif

#/*zte add for lcd common function begin */
config ZTE_LCD_COMMON_FUNCTION
	bool "Support for ZTE lcd common function"
	default y

config ZTE_LCD_BACKLIGHT_LEVEL_CURVE
	depends on ZTE_LCD_COMMON_FUNCTION
	bool "Support for ZTE lcd backlight curve"

config ZTE_LCD_REG_DEBUG
	depends on ZTE_LCD_COMMON_FUNCTION
	bool "Support lcd register debug in root version"

config ZTE_LCD_GPIO_CTRL_POWER
	depends on ZTE_LCD_COMMON_FUNCTION
	bool "Support for ZTE gpio power ctrl"

config ZTE_LCD_DCSBL_CABC_GRADIENT
	depends on ZTE_LCD_COMMON_FUNCTION
	bool "Support for ZTE dcs bl cabc gradient effect"

config ZTE_LCD_ESD_ERROR_CTRL
        bool "Support for lcd esd check error ctrl"
        default n

config ZTE_LCD_ESD_SECOND_CTRL
        bool "Support for two register lcd esd check"
        default n

config ZTE_LCD_CABC_53H_CTRL
        bool "Support for set cabc 53h ctrl"
        default n

config ZTE_LCD_CABC3_EXTREME_POWER_SAVE
	depends on ZTE_LCD_COMMON_FUNCTION
	bool "Support for ZTE extreme power save modem cabc"
config ZTE_LCD_CLOSE_CABC_GRADIENT_BEFORESLEEP
	depends on ZTE_LCD_COMMON_FUNCTION
	bool "Support for ZTE close cabc gradient before sleep for jd9161b"

config ZTE_LCD_FLASH_SCREEN
        bool "Support for lcd flash screen in pv recveory poweroff mode"
	default n
#/*zte add for lcd common function end */
endif
```
