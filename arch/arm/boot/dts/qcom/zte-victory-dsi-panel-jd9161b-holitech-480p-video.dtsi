/* Copyright (c) 2013, The Linux Foundation. All rights reserved.
*
* This program is free software; you can redistribute it and/or modify
* it under the terms of the GNU General Public License version 2 and
* only version 2 as published by the Free Software Foundation.
*
* This program is distributed in the hope that it will be useful,
* but WITHOUT ANY WARRANTY; without even the implied warranty of
* MERCHANTABILITY or FITNESS FOR A PARTICULAR PURPOSE.  See the
* GNU General Public License for more details.
*/

/*---------------------------------------------------------------------------
* This file is autogenerated file using gcdb parser. Please do not edit it.
* Update input XML file to add a new entry or update variable in this file
* VERSION = "1.0"
*---------------------------------------------------------------------------*/
&mdss_mdp {
	dsi_jd9161b_holitech_480p_video: qcom,mdss_dsi_jd9161b_holitech_480p_video {
		qcom,mdss-dsi-panel-name = "jd9161b holitech 480p video mode dsi panel";
		zte,lcd-proc-panel-name = "IC:JD9161B; Glass:HOLITECH; Resolution:480*854_5.0ch";
		qcom,cont-splash-enabled;
		qcom,panel-supply-entries = <&dsi_panel_pwr_supply>;
		qcom,mdss-dsi-panel-controller = <&mdss_dsi0>;
		qcom,mdss-dsi-panel-type = "dsi_video_mode";
		qcom,mdss-dsi-panel-destination = "display_1";
		qcom,mdss-dsi-panel-framerate = <60>;
		qcom,mdss-dsi-virtual-channel-id = <0>;
		qcom,mdss-dsi-stream = <0>;
		qcom,mdss-dsi-panel-width = <480>;
		qcom,mdss-dsi-panel-height = <854>;
		qcom,mdss-dsi-h-front-porch = <20>;
		qcom,mdss-dsi-h-back-porch = <20>;
		qcom,mdss-dsi-h-pulse-width = <10>;
		qcom,mdss-dsi-h-sync-skew = <0>;
		qcom,mdss-dsi-v-back-porch = <15>;
		qcom,mdss-dsi-v-front-porch = <20>;
		qcom,mdss-dsi-v-pulse-width = <2>;
		qcom,mdss-dsi-h-left-border = <0>;
		qcom,mdss-dsi-h-right-border = <0>;
		qcom,mdss-dsi-v-top-border = <0>;
		qcom,mdss-dsi-v-bottom-border = <0>;
		qcom,mdss-dsi-bpp = <24>;
		qcom,mdss-dsi-color-order = "rgb_swap_rgb";
		qcom,mdss-dsi-underflow-color = <0xff>;
		qcom,mdss-dsi-border-color = <0>;
		qcom,mdss-dsi-on-command = [
39 01 00 00 00 00 04 BF 91 61 F2
39 01 00 00 00 00 03 B3 00 77
39 01 00 00 00 00 03 B4 00 77
39 01 00 00 00 00 07 B8 00 A6 01 00 A6 01
39 01 00 00 00 00 04 BA 34 23 00
39 01 00 00 00 00 02 C3 02
39 01 00 00 00 00 03 C4 30 6A
39 01 00 00 00 00 0A C7 00 01 31 05 65 28 11 95 A5
39 01 00 00 00 00 27 C8 7F 7A 69 59 4A 37 36 1E 39 3A 3E 63 58 6B 66 6F 6C 68 63 7F 7A 69 \
59 4A 37 36 1E 39 3A 3E 63 58 6B 66 6F 6C 68 63

39 01 00 00 00 00 11 D4 1E 1F 17 18 06 04 0A 08 00 02 1F 1F 1F 1F 1F 1F
39 01 00 00 00 00 11 D5 1E 1F 17 18 07 05 0B 09 01 03 1F 1F 1F 1F 1F 1F
39 01 00 00 00 00 11 D6 1F 1E 17 18 07 09 0B 05 03 01 1F 1F 1F 1F 1F 1F
39 01 00 00 00 00 11 D7 1F 1E 17 18 06 08 0A 04 02 00 1F 1F 1F 1F 1F 1F
39 01 00 00 00 00 15 D8 20 00 00 30 06 30 01 02 00 01 02 70 6C 00 00 73 0A 70 6C 08
39 01 00 00 00 00 14 D9 00 0F 00 80 00 00 06 7B 00 BC 00 3B 6D 18 00 00 00 03 7B
39 01 00 00 00 00 02 BE 00
39 01 00 00 00 00 02 55 80
39 01 00 00 05 00 02 BE 01
39 01 00 00 00 00 04 E0 01 04 FF
39 01 00 00 00 00 0E EB F6 05 FA 05 05 FB 00 05 08 05 46 FF FF
39 01 00 00 00 00 02 C1 10
//39 01 00 00 00 00 02 C5 07
39 01 00 00 00 00 0B CC 34 20 38 60 11 91 00 40 00 00
39 01 00 00 00 00 02 BE 00
39 01 00 00 00 00 02 51 00
39 01 00 00 00 00 02 53 2C
39 01 00 00 00 00 02 55 81

39 01 00 00 00 00 03 E7 01 12
39 01 00 00 00 00 03 DE 00 03

05 01 00 00 78 00 02 11 00
05 01 00 00 32 00 02 29 00
39 01 00 00 00 00 02 E1 20
		];
		qcom,mdss-dsi-off-command = [
			39 01 00 00 0A 00 02 51 00
			05 01 00 00 32 00 02 28 00
			05 01 00 00 78 00 02 10 00
			39 01 00 00 05 00 02 C6 01
		];
		qcom,mdss-dsi-on-command-state = "dsi_lp_mode";
		qcom,mdss-dsi-off-command-state = "dsi_lp_mode";
		qcom,mdss-dsi-h-sync-pulse = <1>;
		qcom,mdss-dsi-traffic-mode = "burst_mode";
		qcom,mdss-dsi-lane-map = "lane_map_0123";
		qcom,mdss-dsi-bllp-eof-power-mode;
		qcom,mdss-dsi-bllp-power-mode;
		qcom,mdss-dsi-lane-0-state;
		qcom,mdss-dsi-lane-1-state;
		qcom,mdss-dsi-panel-timings = [44 10 06 00 26 2A 0A 12 06 03 04 00];
		qcom,mdss-dsi-t-clk-post = <0x05>;
		qcom,mdss-dsi-t-clk-pre = <0x12>;
		qcom,mdss-dsi-bl-min-level = <3>;
		qcom,mdss-dsi-bl-max-level = <255>;
		qcom,mdss-dsi-dma-trigger = "trigger_sw";
		qcom,mdss-dsi-mdp-trigger = "none";
		qcom,mdss-dsi-bl-pmic-control-type = "bl_ctrl_dcs";
		qcom,mdss-dsi-reset-sequence = <1 10>, <0 10>, <1 120>;
		qcom,mdss-dsi-lp11-init;
		qcom,mdss-dsi-init-delay-us = <7000>;
		qcom,mdss-pan-physical-width-dimension = <62>;
		qcom,mdss-pan-physical-height-dimension = <110>;
	};
};
