/* Copyright (c) 2015, The Linux Foundation. All rights reserved.
 *
 * This program is free software; you can redistribute it and/or modify
 * it under the terms of the GNU General Public License version 2 and
 * only version 2 as published by the Free Software Foundation.
 *
 * This program is distributed in the hope that it will be useful,
 * but WITHOUT ANY WARRANTY; without even the implied warranty of
 * MERCHANTABILITY or FITNESS FOR A PARTICULAR PURPOSE.  See the
 * GNU General Public License for more details.
 */

&mdss_mdp {
	dsi_lce_jd9367_inx_8p0_800P_video_vid: qcom,mdss_dsi_LCE_JD9367_INX_8p0_800p_video {
		qcom,mdss-dsi-panel-name = "zteLCE(JD9367)LNX_800*1280_8P0Inch";
		qcom,mdss-dsi-panel-controller = <&mdss_dsi0>;
		qcom,mdss-dsi-panel-type = "dsi_video_mode";
		qcom,cont-splash-enabled;
		qcom,mdss-pan-physical-width-dimension = <108>;
		qcom,mdss-pan-physical-height-dimension = <173>;
		qcom,mdss-dsi-panel-framerate = <60>;
		qcom,mdss-dsi-virtual-channel-id = <0>;
		qcom,mdss-dsi-stream = <0>;
		qcom,mdss-dsi-panel-destination = "display_1";
		qcom,mdss-dsi-panel-width = <800>;
		qcom,mdss-dsi-panel-height = <1280>;
		qcom,mdss-dsi-h-front-porch = <18>;
		qcom,mdss-dsi-h-back-porch = <18>;
		qcom,mdss-dsi-h-pulse-width = <18>;
		qcom,mdss-dsi-h-sync-skew = <0>;
		qcom,mdss-dsi-v-back-porch = <10>;
		qcom,mdss-dsi-v-front-porch = <30>;
		qcom,mdss-dsi-v-pulse-width = <4>;
		qcom,mdss-dsi-h-left-border = <0>;
		qcom,mdss-dsi-h-right-border = <0>;
		qcom,mdss-dsi-v-top-border = <0>;
		qcom,mdss-dsi-v-bottom-border = <0>;
		qcom,mdss-dsi-bpp = <24>;
		qcom,mdss-dsi-underflow-color = <0xff>;
		qcom,mdss-dsi-border-color = <0>;
		qcom,mdss-dsi-h-sync-pulse = <1>;
		qcom,mdss-dsi-traffic-mode = "burst_mode";
		qcom,mdss-dsi-bllp-eof-power-mode;
		qcom,mdss-dsi-bllp-power-mode;
		qcom,mdss-dsi-lane-0-state;
		qcom,mdss-dsi-lane-1-state;
		qcom,mdss-dsi-lane-2-state;
		qcom,mdss-dsi-lane-3-state;
		qcom,mdss-dsi-panel-timings = [6D 1A 1E 00 3C 42 14 28 15 03 04 00];
		qcom,mdss-dsi-t-clk-post = <0x04>;
		qcom,mdss-dsi-t-clk-pre = <0x1A>;
		qcom,mdss-dsi-bl-min-level = <4>;
		qcom,mdss-dsi-bl-max-level = <255>;
		qcom,mdss-dsi-dma-trigger = "trigger_sw";
		qcom,mdss-dsi-mdp-trigger = "none";
		qcom,ulps-enabled;
		zte,lcm_reset_pin_keep_high_sleeping;
		qcom,suspend-ulps-enabled;
		qcom,mdss-dsi-on-command = [
			39 01 00 00 00 00 02 E0 00
			39 01 00 00 00 00 02 E1 93
			39 01 00 00 00 00 02 E2 65
			39 01 00 00 00 00 02 E3 F8
			39 01 00 00 00 00 02 80 03
			39 01 00 00 00 00 02 E0 04
			39 01 00 00 00 00 02 2D 03
			39 01 00 00 00 00 02 E0 01
			39 01 00 00 00 00 02 00 00
			39 01 00 00 00 00 02 01 6F
			39 01 00 00 00 00 02 17 00
			39 01 00 00 00 00 02 18 D7
			39 01 00 00 00 00 02 19 05
			39 01 00 00 00 00 02 1A 00
			39 01 00 00 00 00 02 1B D7
			39 01 00 00 00 00 02 1C 05
			39 01 00 00 00 00 02 1F 79
			39 01 00 00 00 00 02 20 2D
			39 01 00 00 00 00 02 21 2D
			39 01 00 00 00 00 02 22 4F
			39 01 00 00 00 00 02 26 F1
			39 01 00 00 00 00 02 37 09
			39 01 00 00 00 00 02 38 04
			39 01 00 00 00 00 02 39 08
			39 01 00 00 00 00 02 3A 12
			39 01 00 00 00 00 02 3C 78
			39 01 00 00 00 00 02 3E 80
			39 01 00 00 00 00 02 3F 80
			39 01 00 00 00 00 02 40 06
			39 01 00 00 00 00 02 41 A0
			39 01 00 00 00 00 02 55 01
			39 01 00 00 00 00 02 56 01
			39 01 00 00 00 00 02 57 A8
			39 01 00 00 00 00 02 58 0A
			39 01 00 00 00 00 02 59 2A
			39 01 00 00 00 00 02 5A 37
			39 01 00 00 00 00 02 5B 19
			39 01 00 00 00 00 02 5D 70
			39 01 00 00 00 00 02 5E 50
			39 01 00 00 00 00 02 5F 3F
			39 01 00 00 00 00 02 60 31
			39 01 00 00 00 00 02 61 2D
			39 01 00 00 00 00 02 62 1D
			39 01 00 00 00 00 02 63 22
			39 01 00 00 00 00 02 64 0C
			39 01 00 00 00 00 02 65 25
			39 01 00 00 00 00 02 66 24
			39 01 00 00 00 00 02 67 24
			39 01 00 00 00 00 02 68 41
			39 01 00 00 00 00 02 69 2F
			39 01 00 00 00 00 02 6A 36
			39 01 00 00 00 00 02 6B 28
			39 01 00 00 00 00 02 6C 26
			39 01 00 00 00 00 02 6D 1C
			39 01 00 00 00 00 02 6E 08
			39 01 00 00 00 00 02 6F 02
			39 01 00 00 00 00 02 70 70
			39 01 00 00 00 00 02 71 50
			39 01 00 00 00 00 02 72 3F
			39 01 00 00 00 00 02 73 31
			39 01 00 00 00 00 02 74 2D
			39 01 00 00 00 00 02 75 1D
			39 01 00 00 00 00 02 76 22
			39 01 00 00 00 00 02 77 0C
			39 01 00 00 00 00 02 78 25
			39 01 00 00 00 00 02 79 24
			39 01 00 00 00 00 02 7A 24
			39 01 00 00 00 00 02 7B 41
			39 01 00 00 00 00 02 7C 2F
			39 01 00 00 00 00 02 7D 36
			39 01 00 00 00 00 02 7E 28
			39 01 00 00 00 00 02 7F 26
			39 01 00 00 00 00 02 80 1C
			39 01 00 00 00 00 02 81 08
			39 01 00 00 00 00 02 82 02
			39 01 00 00 00 00 02 E0 02
			39 01 00 00 00 00 02 00 00
			39 01 00 00 00 00 02 01 04
			39 01 00 00 00 00 02 02 06
			39 01 00 00 00 00 02 03 08
			39 01 00 00 00 00 02 04 0A
			39 01 00 00 00 00 02 05 0C
			39 01 00 00 00 00 02 06 0E
			39 01 00 00 00 00 02 07 17
			39 01 00 00 00 00 02 08 37
			39 01 00 00 00 00 02 09 1F
			39 01 00 00 00 00 02 0A 10
			39 01 00 00 00 00 02 0B 1F
			39 01 00 00 00 00 02 0C 1F
			39 01 00 00 00 00 02 0D 1F
			39 01 00 00 00 00 02 0E 1F
			39 01 00 00 00 00 02 0F 1F
			39 01 00 00 00 00 02 10 1F
			39 01 00 00 00 00 02 11 1F
			39 01 00 00 00 00 02 12 1F
			39 01 00 00 00 00 02 13 12
			39 01 00 00 00 00 02 14 1F
			39 01 00 00 00 00 02 15 1F
			39 01 00 00 00 00 02 16 01
			39 01 00 00 00 00 02 17 05
			39 01 00 00 00 00 02 18 07
			39 01 00 00 00 00 02 19 09
			39 01 00 00 00 00 02 1A 0B
			39 01 00 00 00 00 02 1B 0D
			39 01 00 00 00 00 02 1C 0F
			39 01 00 00 00 00 02 1D 17
			39 01 00 00 00 00 02 1E 37
			39 01 00 00 00 00 02 1F 1F
			39 01 00 00 00 00 02 20 11
			39 01 00 00 00 00 02 21 1F
			39 01 00 00 00 00 02 22 1F
			39 01 00 00 00 00 02 23 1F
			39 01 00 00 00 00 02 24 1F
			39 01 00 00 00 00 02 25 1F
			39 01 00 00 00 00 02 26 1F
			39 01 00 00 00 00 02 27 1F
			39 01 00 00 00 00 02 28 1F
			39 01 00 00 00 00 02 29 13
			39 01 00 00 00 00 02 2A 1F
			39 01 00 00 00 00 02 2B 1F
			39 01 00 00 00 00 02 58 10
			39 01 00 00 00 00 02 59 00
			39 01 00 00 00 00 02 5A 00
			39 01 00 00 00 00 02 5B 10
			39 01 00 00 00 00 02 5C 07
			39 01 00 00 00 00 02 5D 30
			39 01 00 00 00 00 02 5E 00
			39 01 00 00 00 00 02 5F 00
			39 01 00 00 00 00 02 60 30
			39 01 00 00 00 00 02 61 03
			39 01 00 00 00 00 02 62 04
			39 01 00 00 00 00 02 63 03
			39 01 00 00 00 00 02 64 6A
			39 01 00 00 00 00 02 65 75
			39 01 00 00 00 00 02 66 0D
			39 01 00 00 00 00 02 67 B3
			39 01 00 00 00 00 02 68 09
			39 01 00 00 00 00 02 69 06
			39 01 00 00 00 00 02 6A 6A
			39 01 00 00 00 00 02 6B 04
			39 01 00 00 00 00 02 6C 00
			39 01 00 00 00 00 02 6D 04
			39 01 00 00 00 00 02 6E 04
			39 01 00 00 00 00 02 6F 88
			39 01 00 00 00 00 02 70 00
			39 01 00 00 00 00 02 71 00
			39 01 00 00 00 00 02 72 06
			39 01 00 00 00 00 02 73 7B
			39 01 00 00 00 00 02 74 00
			39 01 00 00 00 00 02 75 BC
			39 01 00 00 00 00 02 76 00
			39 01 00 00 00 00 02 77 0D
			39 01 00 00 00 00 02 78 2C
			39 01 00 00 00 00 02 79 00
			39 01 00 00 00 00 02 7A 00
			39 01 00 00 00 00 02 7B 00
			39 01 00 00 00 00 02 7C 00
			39 01 00 00 00 00 02 7D 03
			39 01 00 00 00 00 02 7E 7B
			39 01 00 00 00 00 02 E0 04
			39 01 00 00 00 00 02 2B 2B
			39 01 00 00 00 00 02 2E 44
			39 01 00 00 00 00 02 E0 03
			39 01 00 00 00 00 02 98 2E
			39 01 00 00 00 00 02 99 00
			39 01 00 00 00 00 02 9A 01
			39 01 00 00 00 00 02 9B 04
			39 01 00 00 00 00 02 9C 80
			39 01 00 00 00 00 02 E0 00
			39 01 00 00 00 00 02 E6 02
			39 01 00 00 00 00 02 E7 02
			39 01 00 00 00 00 02 51 00
			39 01 00 00 00 00 02 53 24
			39 01 00 00 00 00 02 55 02
			05 01 00 00 78 00 02 11 00
			05 01 00 00 0a 00 02 29 00
		];
		qcom,mdss-dsi-off-command = [
				 39 01 00 00 78 00 02 53 00
				 05 01 00 00 96 00 02 28 00
				 05 01 00 00 96 00 02 10 00];
		qcom,mdss-dsi-on-command-state = "dsi_lp_mode";
		qcom,mdss-dsi-off-command-state = "dsi_hs_mode";
		qcom,mdss-dsi-bl-pmic-control-type ="bl_ctrl_dcs";
		qcom,mdss-dsi-reset-sequence = <1 20>, <0 20>, <1 50>;
		qcom,mdss-dsi-lp11-init;
		qcom,mdss-dsi-init-delay-us = <50000>;
		qcom,mdss-dsi-panel-status-command = [14 01 00 01 05 00 01 0A];
		qcom,mdss-dsi-panel-status-command-mode = "dsi_lp_mode";
		qcom,mdss-dsi-panel-status-check-mode = "reg_read";
		qcom,mdss-dsi-panel-status-read-length = <3>;
		qcom,mdss-dsi-panel-status-value = <0x9C 0x9C 0x9C>;
		qcom,esd-check-enabled;
	};
};
