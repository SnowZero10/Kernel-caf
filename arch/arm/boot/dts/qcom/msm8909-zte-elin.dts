/* Copyright (c) 2016, The Linux Foundation. All rights reserved.
 *
 * This program is free software; you can redistribute it and/or modify
 * it under the terms of the GNU General Public License version 2 and
 * only version 2 as published by the Free Software Foundation.
 *
 * This program is distributed in the hope that it will be useful,
 * but WITHOUT ANY WARRANTY; without even the implied warranty of
 * MERCHANTABILITY or FITNESS FOR A PARTICULAR PURPOSE.  See the
 * GNU General Public License for more details.
 */

/dts-v1/;

#include "msm8909-mtp.dtsi"
#include "msm8909-pm8909.dtsi"
#include "msm8909-pm8909-mtp.dtsi"
#include "zte-msm8909-elin.dtsi"
#include "msm8909-camera-sensor-zte-elin.dtsi"

/ {
	model = "Qualcomm Technologies, Inc. MSM8909-PM8909 512MB MTP";
	compatible = "qcom,msm8909-mtp", "qcom,msm8909", "qcom,mtp";
	qcom,board-id= <8 0x69>;
};

/ {
	mtp_batterydata: qcom,battery-data {
		qcom,rpull-up-kohm = <100000>;
		qcom,vref-batt-therm = <1800000>;
		/delete-node/qcom,palladium-batterydata;

		#include "zte-batterydata-4050mah.dtsi"
	};
};

&pm8909_bms {
	status = "ok";
	qcom,battery-data = <&mtp_batterydata>;

	qcom,v-cutoff-uv = <3400000>;
	qcom,max-voltage-uv = <4400000>;
	qcom,r-conn-mohm = <16>;
	qcom,shutdown-soc-valid-limit = <100>;
	qcom,low-soc-calculate-soc-threshold = <15>;
	qcom,low-voltage-calculate-soc-ms = <1000>;
	qcom,low-soc-calculate-soc-ms = <5000>;
	qcom,calculate-soc-ms = <20000>;
	qcom,volatge-soc-timeout-ms = <60000>;
	qcom,low-voltage-threshold = <3450000>;
	qcom,s3-ocv-tolerence-uv = <1200>;
	qcom,s2-fifo-length = <5>;
	qcom,low-soc-fifo-length = <2>;
	qcom,bms-vadc = <&pm8909_vadc>;
	qcom,bms-adc_tm = <&pm8909_adc_tm>;
	qcom,pmic-revid = <&pm8909_revid>;

	qcom,force-s3-on-suspend;
	qcom,force-s2-in-charging;
	qcom,report-charger-eoc;
	qcom,resume-soc = <97>;
	qcom,use-reported-soc;
	qcom,use-poweroff-soc;
};
