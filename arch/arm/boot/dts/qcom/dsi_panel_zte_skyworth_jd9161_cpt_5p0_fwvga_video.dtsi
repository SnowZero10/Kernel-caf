/* Copyright (c) 2015, The Linux Foundation. All rights reserved.
 *
 * This program is free software; you can redistribute it and/or modify
 * it under the terms of the GNU General Public License version 2 and
 * only version 2 as published by the Free Software Foundation.
 *
 * This program is distributed in the hope that it will be useful,
 * but WITHOUT ANY WARRANTY; without even the implied warranty of
 * MERCHANTABILITY or FITNESS FOR A PARTICULAR PURPOSE.  See the
 * GNU General Public License for more details.
 */

&mdss_mdp {
	dsi_skyworth_jd9161_fwvga_video: qcom,mdss_dsi_skyworth_jd9161_cpt_5p_fwvga_video {
		qcom,mdss-dsi-panel-name = "zteSKYWORTH_jd9161_cpt_480_854_5.0Inch";
		qcom,mdss-dsi-panel-controller = <&mdss_dsi0>;
		qcom,mdss-dsi-panel-type = "dsi_video_mode";
		qcom,mdss-dsi-panel-destination = "display_1";
		qcom,mdss-dsi-panel-framerate = <60>;
		qcom,mdss-dsi-virtual-channel-id = <0>;
		qcom,mdss-dsi-stream = <0>;
		qcom,mdss-pan-physical-height-dimension = <110>;
		qcom,mdss-pan-physical-width-dimension = <62>;
		qcom,mdss-dsi-panel-width = <480>;
		qcom,mdss-dsi-panel-height = <854>;
		qcom,mdss-dsi-h-front-porch = <6>;
		qcom,mdss-dsi-h-back-porch = <6>;
		qcom,mdss-dsi-h-pulse-width = <6>;
		qcom,mdss-dsi-h-sync-skew = <0>;
		qcom,mdss-dsi-v-back-porch = <8>;
		qcom,mdss-dsi-v-front-porch = <8>;
		qcom,mdss-dsi-v-pulse-width = <4>;
		qcom,mdss-dsi-h-left-border = <0>;
		qcom,mdss-dsi-h-right-border = <0>;
		qcom,mdss-dsi-v-top-border = <0>;
		qcom,mdss-dsi-v-bottom-border = <0>;
		qcom,mdss-dsi-bpp = <24>;
		qcom,mdss-dsi-color-order = "rgb_swap_rgb";
		qcom,mdss-dsi-underflow-color = <0xff>;
		qcom,mdss-dsi-border-color = <0>;
		qcom,mdss-dsi-on-command = [
			39 01 00 00 00 00 04 BF 91 61 F2

			39 01 00 00 00 00 03 B3 00 6B //VCOM

			39 01 00 00 00 00 03 B4 00 73 //VCOM_R

			39 01 00 00 00 00 07 B8 00 B6 01 00 B6 01 //VGMP, VGSP, VGMN, VGSN

			39 01 00 00 00 00 04 BA 34 23 00 //GIP output voltage level

			39 01 00 00 00 00 02 C3 02 //SET RGB CYC

			39 01 00 00 00 00 03 C4 30 6A //SET TCON

			39 01 00 00 00 00 0A C7 00 01 31 05 65 2C 13 A5 A5 //POWER CTRL

			39 01 00 00 00 00 27 C8 79 5C 4F 3E 37 24 27 10 2B 2D 30 54 49 5A 54 5B
			56 4D 41 79 5C 4F 3E 37 24 27 10 2B 2D 30 54 49 5A 54 5B 56 4D 41 //Gamma 2.2

			39 01 00 00 00 00 11 D4 1F 1E 1F 00 10 1F 1F 04 08 06 0A 1F 1F 1F 1F 1F

			39 01 00 00 00 00 11 D5 1F 1E 1F 01 11 1F 1F 05 09 07 0B 1F 1F 1F 1F 1F

			39 01 00 00 00 00 11 D6 1F 1F 1E 11 01 1F 1F 09 05 07 0B 1F 1F 1F 1F 1F

			39 01 00 00 00 00 11 D7 1F 1F 1E 10 00 1F 1F 08 04 06 0A 1F 1F 1F 1F 1F

			39 01 00 00 00 00 15 D8 20 02 0A 10 05 30 01 02 30 01 02 06 70 53 61 73 09 06 70 08

			39 01 00 00 00 00 14 D9 00 0A 0A 88 00 00 06 7B 00 00 00 3B 2F 1F 00 00 00 03 7B

			39 01 00 00 00 00 02 BE 01

			39 01 00 00 00 00 02 C1 10

			39 01 00 00 00 00 0B CC 34 20 38 60 11 91 00 40 00 00

			39 01 00 00 00 00 02 BE 00
			39 01 00 00 00 00 02 55 02
			39 01 00 00 00 00 02 51 00
			39 01 00 00 00 00 02 53 2c
			05 01 00 00 78 00 02 11 00
			05 01 00 00 14 00 02 29 00
			39 01 00 00 00 00 04 BF 09 B1 7F
		];
		qcom,mdss-dsi-off-command = [
			39 01 00 00 00 00 04 BF 91 61 F2
			39 01 00 00 0A 00 02 53 00
			05 01 00 00 0A 00 02 28 00
			05 01 00 00 78 00 02 10 00
			39 01 00 00 00 00 04 BF 09 B1 7F
		];
		zte,lcm_reset_pin_keep_high_sleeping;
		qcom,mdss-dsi-on-command-state = "dsi_lp_mode";
		qcom,mdss-dsi-off-command-state = "dsi_hs_mode";
		qcom,mdss-dsi-h-sync-pulse = <1>;
		qcom,mdss-dsi-traffic-mode = "burst_mode";
		qcom,mdss-dsi-lane-map = "lane_map_0123";
		qcom,mdss-dsi-bllp-eof-power-mode;
		qcom,mdss-dsi-bllp-power-mode;
		qcom,suspend-ulps-enabled;
		qcom,mdss-dsi-lane-0-state;
		qcom,mdss-dsi-lane-1-state;
		qcom,mdss-dsi-panel-timings = [38 14 0A 00 26 C8 10 14 06 03 04 00];
		qcom,mdss-dsi-t-clk-post = <0x05>;
		qcom,mdss-dsi-t-clk-pre = <0x10>;
		qcom,mdss-dsi-bl-min-level = <2>;
		qcom,mdss-dsi-bl-max-level = <255>;
		qcom,mdss-dsi-dma-trigger = "trigger_sw";
		qcom,mdss-dsi-mdp-trigger = "none";
		qcom,mdss-dsi-bl-pmic-control-type = "bl_ctrl_dcs";
		qcom,mdss-dsi-reset-sequence = <1 20>, <0 5>, <1 20>;
		qcom,mdss-dsi-lp11-init;
		qcom,mdss-dsi-init-delay-us = <7000>;
		qcom,mdss-dsi-panel-status-command = [04 01 00 01 05 00 01 0A];
		qcom,mdss-dsi-panel-status-command-second  = [14 01 00 01 05 00 01 09];
		qcom,mdss-dsi-panel-status-value-second = <0x80 0x80 0x80>;
		qcom,mdss-dsi-panel-status-command-mode = "dsi_hs_mode";
		qcom,mdss-dsi-panel-status-check-mode = "reg_read";
		qcom,mdss-dsi-panel-status-read-length = <3>;
		qcom,mdss-dsi-panel-status-value = <0x9C 0x9C 0x9C>;
		qcom,mdss-dsi-panel-status-valid-params = <1>;
		qcom,esd-check-enabled;
	};
};
