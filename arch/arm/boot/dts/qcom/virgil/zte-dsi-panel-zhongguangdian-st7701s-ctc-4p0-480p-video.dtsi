/* Copyright (c) 2013, The Linux Foundation. All rights reserved.
 *
 * This program is free software; you can redistribute it and/or modify
 * it under the terms of the GNU General Public License version 2 and
 * only version 2 as published by the Free Software Foundation.
 *
 * This program is distributed in the hope that it will be useful,
 * but WITHOUT ANY WARRANTY; without even the implied warranty of
 * MERCHANTABILITY or FITNESS FOR A PARTICULAR PURPOSE.  See the
 * GNU General Public License for more details.
 */

/*---------------------------------------------------------------------------
 * This file is autogenerated file using gcdb parser. Please do not edit it.
 * Update input XML file to add a new entry or update variable in this file
 * VERSION = "1.0"
 *---------------------------------------------------------------------------*/
&mdss_mdp {
	dsi_zhongguangdian_st7701s_ctc_4p0_480p_video: qcom,mdss_dsi_zhongguangdian_st7701s_ctc_4p0_480p_video {
		qcom,mdss-dsi-panel-name = "zhongguangdian st7701s ctc 4p0 480p video mode dsi panel 20180402";
		qcom,cont-splash-enabled;
		qcom,panel-supply-entries = <&dsi_panel_pwr_supply>;
		qcom,mdss-dsi-panel-controller = <&mdss_dsi0>;
		qcom,mdss-dsi-panel-type = "dsi_video_mode";
		qcom,mdss-dsi-panel-destination = "display_1";
		qcom,mdss-dsi-panel-framerate = <60>;
		qcom,mdss-dsi-virtual-channel-id = <0>;
		qcom,mdss-dsi-stream = <0>;
		qcom,mdss-pan-physical-height-dimension = <86>;
		qcom,mdss-pan-physical-width-dimension = <52>;
		qcom,mdss-dsi-panel-width = <480>;
		qcom,mdss-dsi-panel-height = <800>;
		qcom,mdss-dsi-h-front-porch = <38>;
		qcom,mdss-dsi-h-back-porch = <46>;
		qcom,mdss-dsi-h-pulse-width = <8>;
		qcom,mdss-dsi-h-sync-skew = <0>;
		qcom,mdss-dsi-v-back-porch = <12>;
		qcom,mdss-dsi-v-front-porch = <18>;
		qcom,mdss-dsi-v-pulse-width = <2>;
		qcom,mdss-dsi-h-left-border = <0>;
		qcom,mdss-dsi-h-right-border = <0>;
		qcom,mdss-dsi-v-top-border = <0>;
		qcom,mdss-dsi-v-bottom-border = <0>;
		qcom,mdss-dsi-bpp = <24>;
		qcom,mdss-dsi-color-order = "rgb_swap_rgb";
		qcom,mdss-dsi-underflow-color = <0xff>;
		qcom,mdss-dsi-border-color = <0>;
		qcom,mdss-dsi-on-command = [05 01 00 00 20 00 02 11 00
39 01 00 00 00 00 06 ff 77 01 00 00 10
39 01 00 00 00 00 03 c0 63 00
39 01 00 00 00 00 03 c1 0c 07
39 01 00 00 00 00 03 c2 31 08
39 01 00 00 00 00 02 cc 10
39 01 00 00 00 00 02 ca 11
39 01 00 00 00 00 02 bb 00
39 01 00 00 00 00 02 bc 01
39 01 00 00 00 00 11 b0 40 02 87 0e 15 0a 03 0a 0a 18 08 16 13 07 09 19
39 01 00 00 00 00 11 b1 40 01 86 0d 13 09 03 0a 09 1c 09 15 13 91 16 19
39 01 00 00 00 00 06 ff 77 01 00 00 11
39 01 00 00 00 00 02 b0 4d
39 01 00 00 00 00 02 b1 64
39 01 00 00 00 00 02 b2 07
39 01 00 00 00 00 02 b3 80
39 01 00 00 00 00 02 b5 47
39 01 00 00 00 00 02 b7 85
39 01 00 00 00 00 02 b8 21
39 01 00 00 00 00 02 b9 10
39 01 00 00 00 00 02 c1 78
39 01 00 00 00 00 02 c2 78
39 01 00 00 64 00 02 d0 88
39 01 00 00 00 00 04 e0 00 b4 02
39 01 00 00 00 00 0c e1 06 00 00 00 05 00 00 00 00 20 20
39 01 00 00 00 00 0e e2 00 00 01 00 00 00 03 00 00 00 00 00 00
39 01 00 00 00 00 05 e3 00 00 33 33
39 01 00 00 00 00 03 e4 44 44
39 01 00 00 00 00 11 e5 09 31 be a0 0b 31 be a0 05 31 be a0 07 31 be a0
39 01 00 00 00 00 05 e6 00 00 33 33
39 01 00 00 00 00 03 e7 44 44
39 01 00 00 00 00 11 e8 08 31 be a0 0a 31 be a0 04 31 be a0 06 31 be a0
39 01 00 00 00 00 11 ea 10 00 10 00 10 00 10 00 10 00 10 00 10 00 10 00
39 01 00 00 00 00 08 eb 02 02 00 00 00 00 00
39 01 00 00 00 00 03 ec 02 00
39 01 00 00 00 00 11 ed f5 47 6f 0b 8f 9f ff ff ff ff f9 f8 b0 f6 74 5f
39 01 00 00 00 00 0d ef 08 08 08 08 08 08 04 04 04 04 04 04
39 01 00 00 00 00 06 ff 77 01 00 00 00
39 01 00 00 00 00 02 51 00
39 01 00 00 00 00 02 53 0C
39 01 00 00 00 00 02 55 00
39 01 00 00 00 00 02 5e 03
05 01 00 00 20 00 02 29 00
];
		qcom,mdss-dsi-off-command = [39 01 00 00 00 00 02 53 00
					05 01 00 00 32 00 02 28 00
					05 01 00 00 78 00 02 10 00];
		qcom,mdss-dsi-on-command-state = "dsi_lp_mode";
		qcom,mdss-dsi-off-command-state = "dsi_lp_mode";
		qcom,mdss-dsi-h-sync-pulse = <1>;
		qcom,mdss-dsi-traffic-mode = "burst_mode";
		qcom,mdss-dsi-lane-map = "lane_map_0123";
		qcom,mdss-dsi-bllp-eof-power-mode;
		qcom,mdss-dsi-bllp-power-mode;
		qcom,suspend-ulps-enabled;
		qcom,mdss-dsi-lane-0-state;
		qcom,mdss-dsi-lane-1-state;
		qcom,mdss-dsi-panel-timings = [6B 16 0C 00 38 3A 12 18 11 03 04 00];
		qcom,mdss-dsi-t-clk-post = <0x04>;
		qcom,mdss-dsi-t-clk-pre = <0x17>;
		qcom,mdss-dsi-bl-min-level = <4>;
		qcom,mdss-dsi-bl-max-level = <255>;
		qcom,mdss-dsi-dma-trigger = "trigger_sw";
		qcom,mdss-dsi-mdp-trigger = "none";
		qcom,mdss-dsi-bl-pmic-control-type = "bl_ctrl_dcs";
		qcom,mdss-dsi-reset-sequence = <1 10>, <0 20>, <1 50>;
		qcom,mdss-dsi-lp11-init;
		zte,mdss-dsi-cabc-53h-value = <0x0c>;
		//qcom,mdss-dsi-init-delay-us = <7000>;
		qcom,mdss-dsi-panel-status-command = [04 01 00 01 05 00 01 0A];
		qcom,mdss-dsi-panel-status-command-second  = [14 01 00 01 05 00 01 09];
		qcom,mdss-dsi-panel-status-value-second = <0x80>;
		qcom,mdss-dsi-panel-status-command-mode = "dsi_hs_mode";
		qcom,mdss-dsi-panel-status-check-mode = "reg_read_jd9161";
		qcom,mdss-dsi-panel-status-read-length = <1>;
		qcom,mdss-dsi-panel-status-value = <0x9C>;
		//qcom,esd-check-enabled;
		qcom,esd-check-enabled-second;
	};
};
