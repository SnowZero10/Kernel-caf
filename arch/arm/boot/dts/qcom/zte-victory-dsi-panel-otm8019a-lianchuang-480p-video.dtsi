/* Copyright (c) 2013, The Linux Foundation. All rights reserved.
*
* This program is free software; you can redistribute it and/or modify
* it under the terms of the GNU General Public License version 2 and
* only version 2 as published by the Free Software Foundation.
*
* This program is distributed in the hope that it will be useful,
* but WITHOUT ANY WARRANTY; without even the implied warranty of
* MERCHANTABILITY or FITNESS FOR A PARTICULAR PURPOSE.  See the
* GNU General Public License for more details.
*/

/*---------------------------------------------------------------------------
* This file is autogenerated file using gcdb parser. Please do not edit it.
* Update input XML file to add a new entry or update variable in this file
* VERSION = "1.0"
*---------------------------------------------------------------------------*/

&mdss_mdp {
	dsi_otm8019a_lianchuang_480p_video: qcom,mdss_dsi_otm8019a_lianchuang_480p_video {
		qcom,mdss-dsi-panel-name = "otm8019a lianchuang 480p video mode dsi panel";
		zte,lcd-proc-panel-name = "IC:OTM8019A; Glass:LIANCHUANG; Resolution:480*854_5.0ch";
		qcom,cont-splash-enabled;
		qcom,panel-supply-entries = <&dsi_panel_pwr_supply>;
		qcom,mdss-dsi-panel-controller = <&mdss_dsi0>;
		qcom,mdss-dsi-panel-type = "dsi_video_mode";
		qcom,mdss-dsi-panel-destination = "display_1";
		qcom,mdss-dsi-panel-framerate = <60>;
		qcom,mdss-dsi-virtual-channel-id = <0>;
		qcom,mdss-dsi-stream = <0>;
		qcom,mdss-dsi-panel-width = <480>;
		qcom,mdss-dsi-panel-height = <854>;
		qcom,mdss-dsi-h-front-porch = <20>;
		qcom,mdss-dsi-h-back-porch = <20>;
		qcom,mdss-dsi-h-pulse-width = <10>;
		qcom,mdss-dsi-h-sync-skew = <0>;
		qcom,mdss-dsi-v-back-porch = <15>;
		qcom,mdss-dsi-v-front-porch = <20>;
		qcom,mdss-dsi-v-pulse-width = <2>;
		qcom,mdss-dsi-h-left-border = <0>;
		qcom,mdss-dsi-h-right-border = <0>;
		qcom,mdss-dsi-v-top-border = <0>;
		qcom,mdss-dsi-v-bottom-border = <0>;
		qcom,mdss-dsi-bpp = <24>;
		qcom,mdss-dsi-color-order = "rgb_swap_rgb";
		qcom,mdss-dsi-underflow-color = <0xff>;
		qcom,mdss-dsi-border-color = <0>;
		qcom,mdss-dsi-on-command = [
			29 01 00 00 00 00 02 00 00
			29 01 00 00 00 00 04 FF 80 19 01
			29 01 00 00 00 00 02 00 80
			29 01 00 00 00 00 03 FF 80 19
			29 01 00 00 00 00 02 00 90
			29 01 00 00 00 00 02 B3 02
			29 01 00 00 00 00 02 00 92
			29 01 00 00 00 00 02 B3 45
			29 01 00 00 00 00 02 00 A6
			29 01 00 00 00 00 03 B3 20 01
			29 01 00 00 00 00 02 00 A3
			29 01 00 00 00 00 02 C0 1B
			29 01 00 00 00 00 02 00 B4
			29 01 00 00 00 00 02 C0 77
			29 01 00 00 00 00 02 00 81
			29 01 00 00 00 00 02 C4 04
			29 01 00 00 00 00 02 00 80
			29 01 00 00 00 00 02 C5 03
			29 01 00 00 00 00 02 00 90
			29 01 00 00 00 00 07 C0 00 15 00 00 00 03
			29 01 00 00 00 00 02 00 82
			29 01 00 00 00 00 02 C5 b0
			29 01 00 00 00 00 02 00 90
			29 01 00 00 00 00 06 C5 4e 2B 04 7B 33
			29 01 00 00 00 00 02 00 00
			29 01 00 00 00 00 03 D8 65 65
			29 01 00 00 00 00 02 00 00
			29 01 00 00 00 00 02 D9 5d
			29 01 00 00 00 00 02 00 80
			29 01 00 00 00 00 03 C1 03 33
			29 01 00 00 00 00 02 00 80
			29 01 00 00 00 00 0D CE 86 01 00 85 01 00 00 00 00 00 00 00
			29 01 00 00 00 00 02 00 90
			29 01 00 00 00 00 0F CE 00 00 00 00 00 00 00 00 00 00 00 00 00 00
			29 01 00 00 00 00 02 00 A0
			29 01 00 00 00 00 0F CE 18 03 03 5A 00 00 00 18 02 03 5B 00 00 00
			29 01 00 00 00 00 02 00 B0
			29 01 00 00 00 00 0F CE 18 05 03 5C 00 00 00 18 04 03 5D 00 00 00
			29 01 00 00 00 00 02 00 C0
			29 01 00 00 00 00 0F CE 18 05 03 5A 00 00 00 18 04 03 5B 00 00 00
			29 01 00 00 00 00 02 00 D0
			29 01 00 00 00 00 0F CE 18 03 03 5C 00 00 00 18 02 03 5D 00 00 00
			29 01 00 00 00 00 02 00 80
			29 01 00 00 00 00 0F CF 00 00 00 00 00 00 00 00 00 00 00 00 00 00
			29 01 00 00 00 00 02 00 90
			29 01 00 00 00 00 0F CF 00 00 00 00 00 00 00 00 00 00 00 00 00 00
			29 01 00 00 00 00 02 00 A0
			29 01 00 00 00 00 0F CF 00 00 00 00 00 00 00 00 00 00 00 00 00 00
			29 01 00 00 00 00 02 00 B0
			29 01 00 00 00 00 0F CF 00 00 00 00 00 00 00 00 00 00 00 00 00 00
			29 01 00 00 00 00 02 00 C0
			29 01 00 00 00 00 0B CF 01 01 20 20 00 00 01 00 00 00
			29 01 00 00 00 00 02 00 D0
			29 01 00 00 00 00 02 CF 00
			29 01 00 00 00 00 02 00 90
			29 01 00 00 00 00 10 CB 00 00 00 00 00 00 00 00 00 00 00 00 00 00 00
			29 01 00 00 00 00 02 00 A0
			29 01 00 00 00 00 02 CB 00
			29 01 00 00 00 00 02 00 A5
			29 01 00 00 00 00 0B CB 00 00 00 00 00 00 00 00 00 00
			29 01 00 00 00 00 02 00 B0
			29 01 00 00 00 00 07 CB 00 00 00 00 00 00
			29 01 00 00 00 00 02 00 C0
			29 01 00 00 00 00 10 CB 00 01 01 01 01 01 00 00 00 00 00 00 00 00 00
			29 01 00 00 00 00 02 00 D0
			29 01 00 00 00 00 02 CB 00
			29 01 00 00 00 00 02 00 D5
			29 01 00 00 00 00 0B CB 00 00 00 00 00 00 00 00 00 00
			29 01 00 00 00 00 02 00 E0
			29 01 00 00 00 00 07 CB 01 01 01 01 01 00
			29 01 00 00 00 00 02 00 80
			29 01 00 00 00 00 0B CC 00 26 09 0B 01 25 00 00 00 00
			29 01 00 00 00 00 02 00 90
			29 01 00 00 00 00 07 CC 00 00 00 00 00 00
			29 01 00 00 00 00 02 00 9A
			29 01 00 00 00 00 06 CC 00 00 00 00 00
			29 01 00 00 00 00 02 00 A0
			29 01 00 00 00 00 0C CC 00 00 00 00 00 25 02 0C 0A 26 00
			29 01 00 00 00 00 02 00 B0
			29 01 00 00 00 00 0B CC 00 25 10 0E 02 26 00 00 00 00
			29 01 00 00 00 00 02 00 C0
			29 01 00 00 00 00 07 CC 00 00 00 00 00 00
			29 01 00 00 00 00 02 00 CA
			29 01 00 00 00 00 06 CC 00 00 00 00 00
			29 01 00 00 00 00 02 00 D0
			29 01 00 00 00 00 0C CC 00 00 00 00 00 26 01 0D 0F 25 00
			29 01 00 00 00 00 02 00 00
			29 01 00 00 00 00 15 E1 00 2f 3f 4c 5c 68 69 8f 7d 95 70 5c 71 50 4d 40 35 25 1c 04
			29 01 00 00 00 00 02 00 00
			29 01 00 00 00 00 15 E2 00 2f 3f 4c 5b 68 69 8f 7d 95 70 5c 71 50 4d 40 34 25 1c 04
			29 01 00 00 00 00 02 00 80
			29 01 00 00 00 00 02 C4 30
			29 01 00 00 00 00 02 00 98
			29 01 00 00 00 00 02 C0 00
			29 01 00 00 00 00 02 00 a9
			29 01 00 00 00 00 02 C0 0A
			29 01 00 00 00 00 02 00 b0
			29 01 00 00 00 00 04 C1 20 00 00
			29 01 00 00 00 00 02 00 e1
			29 01 00 00 00 00 03 C0 40 30
			29 01 00 00 00 00 02 00 80
			29 01 00 00 00 00 03 C1 03 33
			29 01 00 00 00 00 02 00 A0
			29 01 00 00 00 00 02 C1 e8
			29 01 00 00 00 00 02 00 90
			29 01 00 00 00 00 02 b6 b4
			29 01 00 00 0A 00 02 00 00
			29 01 00 00 0A 00 02 fb 01
			29 01 00 00 0A 00 02 00 00
			29 01 00 00 0A 00 04 FF FF FF FF
			//29 01 00 00 0A 00 02 21 00
			29 01 00 00 00 00 02 51 00
			29 01 00 00 00 00 02 53 2C
			29 01 00 00 00 00 02 55 01
			05 01 00 00 78 00 02 11 00
			05 01 00 00 28 00 02 29 00
		];
		qcom,mdss-dsi-off-command = [
			05 01 00 00 32 00 02 28 00
			05 01 00 00 78 00 02 10 00
		];
		qcom,mdss-dsi-on-command-state = "dsi_lp_mode";
		qcom,mdss-dsi-off-command-state = "dsi_hs_mode";
		qcom,mdss-dsi-h-sync-pulse = <1>;
		qcom,mdss-dsi-traffic-mode = "burst_mode";
		qcom,mdss-dsi-lane-map = "lane_map_0123";
		qcom,mdss-dsi-bllp-eof-power-mode;
		qcom,mdss-dsi-bllp-power-mode;
		qcom,mdss-dsi-lane-0-state;
		qcom,mdss-dsi-lane-1-state;
		qcom,mdss-dsi-panel-timings = [44 10 06 00 26 2A 0A 12 06 03 04 00];
		qcom,mdss-dsi-t-clk-post = <0x05>;
		qcom,mdss-dsi-t-clk-pre = <0x12>;
		qcom,mdss-dsi-bl-min-level = <1>;
		qcom,mdss-dsi-bl-max-level = <255>;
		qcom,mdss-dsi-dma-trigger = "trigger_sw";
		qcom,mdss-dsi-mdp-trigger = "none";
		qcom,mdss-dsi-bl-pmic-control-type = "bl_ctrl_dcs";
		qcom,mdss-dsi-reset-sequence = <1 10>, <0 10>, <1 120>;
		qcom,mdss-dsi-lp11-init;
		qcom,mdss-dsi-init-delay-us = <7000>;
		qcom,mdss-pan-physical-width-dimension = <62>;
		qcom,mdss-pan-physical-height-dimension = <110>;
	};
};

