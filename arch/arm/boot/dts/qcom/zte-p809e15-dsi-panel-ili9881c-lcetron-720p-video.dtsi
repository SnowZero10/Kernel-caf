/* Copyright (c) 2015-2016, The Linux Foundation. All rights reserved.
*
* This program is free software; you can redistribute it and/or modify
* it under the terms of the GNU General Public License version 2 and
* only version 2 as published by the Free Software Foundation.
*
* This program is distributed in the hope that it will be useful,
* but WITHOUT ANY WARRANTY; without even the implied warranty of
* MERCHANTABILITY or FITNESS FOR A PARTICULAR PURPOSE.  See the
* GNU General Public License for more details.
*/
&mdss_mdp {
	dsi_ili9881c_lcetron_p809s15_720p_video: qcom,mdss_dsi_ili9881c_lcetron_p809s15_720p_video {
		qcom,mdss-dsi-panel-name = "ili9881c lcetron 720p video mode dsi panel";
		qcom,panel-supply-entries = <&dsi_panel_pwr_supply>;
		zte,panel-reset-early-enabled;
		qcom,cont-splash-enabled;
		qcom,mdss-dsi-panel-controller = <&mdss_dsi0>;
		qcom,mdss-dsi-panel-type = "dsi_video_mode";
		qcom,mdss-dsi-panel-destination = "display_1";
		qcom,mdss-dsi-panel-framerate = <60>;
		qcom,mdss-dsi-virtual-channel-id = <0>;
		qcom,mdss-dsi-stream = <0>;
		qcom,mdss-dsi-panel-width = <720>;
		qcom,mdss-dsi-panel-height = <1280>;
		qcom,mdss-dsi-h-front-porch = <85>;
		qcom,mdss-dsi-h-back-porch = <60>;
		qcom,mdss-dsi-h-pulse-width = <40>;
		qcom,mdss-dsi-h-sync-skew = <0>;
		qcom,mdss-dsi-v-front-porch = <20>;
		qcom,mdss-dsi-v-back-porch = <20>;
		qcom,mdss-dsi-v-pulse-width = <10>;
		qcom,mdss-dsi-h-left-border = <0>;
		qcom,mdss-dsi-h-right-border = <0>;
		qcom,mdss-dsi-v-top-border = <0>;
		qcom,mdss-dsi-v-bottom-border = <0>;
		qcom,mdss-dsi-bpp = <24>;
		qcom,mdss-dsi-underflow-color = <0xff>;
		qcom,mdss-dsi-border-color = <0>;
		qcom,mdss-dsi-h-sync-pulse = <0>;
		qcom,mdss-dsi-traffic-mode = "burst_mode";
		qcom,mdss-dsi-bllp-eof-power-mode;
		qcom,mdss-dsi-bllp-power-mode;
		qcom,mdss-dsi-lane-0-state;
		qcom,mdss-dsi-lane-1-state;
		qcom,mdss-dsi-lane-2-state;
		qcom,mdss-dsi-lane-3-state;
		qcom,mdss-dsi-panel-timings = [7A 1A 12 00 40 42 16 1E 14 03 04 00];
		qcom,mdss-dsi-t-clk-post = <0x04>;
		qcom,mdss-dsi-t-clk-pre = <0x1A>;
		qcom,mdss-dsi-bl-min-level = <160>;
		qcom,mdss-dsi-bl-max-level = <3950>;
		qcom,mdss-dsi-dma-trigger = "trigger_sw";
		qcom,mdss-dsi-mdp-trigger = "none";
		qcom,mdss-dsi-on-command = [
39 01 00 00 00 00 04 FF 98 81 03
39 01 00 00 00 00 02 01 00
39 01 00 00 00 00 02 02 00
39 01 00 00 00 00 02 03 73
39 01 00 00 00 00 02 04 00
39 01 00 00 00 00 02 05 00
39 01 00 00 00 00 02 06 0C
39 01 00 00 00 00 02 07 00
39 01 00 00 00 00 02 08 00
39 01 00 00 00 00 02 09 19
39 01 00 00 00 00 02 0A 01
39 01 00 00 00 00 02 0B 01
39 01 00 00 00 00 02 0C 0B
39 01 00 00 00 00 02 0D 01
39 01 00 00 00 00 02 0E 01
39 01 00 00 00 00 02 0F 19
39 01 00 00 00 00 02 10 1D
39 01 00 00 00 00 02 11 00
39 01 00 00 00 00 02 12 00
39 01 00 00 00 00 02 13 02
39 01 00 00 00 00 02 14 00
39 01 00 00 00 00 02 15 00
39 01 00 00 00 00 02 16 00
39 01 00 00 00 00 02 17 00
39 01 00 00 00 00 02 18 00
39 01 00 00 00 00 02 19 00
39 01 00 00 00 00 02 1A 00
39 01 00 00 00 00 02 1B 00
39 01 00 00 00 00 02 1C 00
39 01 00 00 00 00 02 1D 00
39 01 00 00 00 00 02 1E 44
39 01 00 00 00 00 02 1F C0
39 01 00 00 00 00 02 20 0A
39 01 00 00 00 00 02 21 03
39 01 00 00 00 00 02 22 0A
39 01 00 00 00 00 02 23 00
39 01 00 00 00 00 02 24 8C
39 01 00 00 00 00 02 25 8C
39 01 00 00 00 00 02 26 00
39 01 00 00 00 00 02 27 00
39 01 00 00 00 00 02 28 3B
39 01 00 00 00 00 02 29 03
39 01 00 00 00 00 02 2A 00
39 01 00 00 00 00 02 2B 00
39 01 00 00 00 00 02 2C 00
39 01 00 00 00 00 02 2D 00
39 01 00 00 00 00 02 2E 00
39 01 00 00 00 00 02 2F 00
39 01 00 00 00 00 02 30 00
39 01 00 00 00 00 02 31 00
39 01 00 00 00 00 02 32 00
39 01 00 00 00 00 02 33 00
39 01 00 00 00 00 02 34 00
39 01 00 00 00 00 02 35 00
39 01 00 00 00 00 02 36 00
39 01 00 00 00 00 02 37 00
39 01 00 00 00 00 02 38 00
39 01 00 00 00 00 02 39 00
39 01 00 00 00 00 02 3A 00
39 01 00 00 00 00 02 3B 00
39 01 00 00 00 00 02 3C 00
39 01 00 00 00 00 02 3D 00
39 01 00 00 00 00 02 3E 00
39 01 00 00 00 00 02 3F 00
39 01 00 00 00 00 02 40 00
39 01 00 00 00 00 02 41 00
39 01 00 00 00 00 02 42 00
39 01 00 00 00 00 02 43 00
39 01 00 00 00 00 02 44 00
39 01 00 00 00 00 02 50 01
39 01 00 00 00 00 02 51 23
39 01 00 00 00 00 02 52 45
39 01 00 00 00 00 02 53 67
39 01 00 00 00 00 02 54 89
39 01 00 00 00 00 02 55 AB
39 01 00 00 00 00 02 56 01
39 01 00 00 00 00 02 57 23
39 01 00 00 00 00 02 58 45
39 01 00 00 00 00 02 59 67
39 01 00 00 00 00 02 5A 89
39 01 00 00 00 00 02 5B AB
39 01 00 00 00 00 02 5C CD
39 01 00 00 00 00 02 5D EF
39 01 00 00 00 00 02 5E 11
39 01 00 00 00 00 02 5F 02
39 01 00 00 00 00 02 60 00
39 01 00 00 00 00 02 61 0C
39 01 00 00 00 00 02 62 0D
39 01 00 00 00 00 02 63 0E
39 01 00 00 00 00 02 64 0F
39 01 00 00 00 00 02 65 02
39 01 00 00 00 00 02 66 02
39 01 00 00 00 00 02 67 02
39 01 00 00 00 00 02 68 02
39 01 00 00 00 00 02 69 02
39 01 00 00 00 00 02 6A 02
39 01 00 00 00 00 02 6B 02
39 01 00 00 00 00 02 6C 02
39 01 00 00 00 00 02 6D 02
39 01 00 00 00 00 02 6E 05
39 01 00 00 00 00 02 6F 05
39 01 00 00 00 00 02 70 05
39 01 00 00 00 00 02 71 05
39 01 00 00 00 00 02 72 01
39 01 00 00 00 00 02 73 06
39 01 00 00 00 00 02 74 07
39 01 00 00 00 00 02 75 02
39 01 00 00 00 00 02 76 00
39 01 00 00 00 00 02 77 0C
39 01 00 00 00 00 02 78 0D
39 01 00 00 00 00 02 79 0E
39 01 00 00 00 00 02 7A 0F
39 01 00 00 00 00 02 7B 02
39 01 00 00 00 00 02 7C 02
39 01 00 00 00 00 02 7D 02
39 01 00 00 00 00 02 7E 02
39 01 00 00 00 00 02 7F 02
39 01 00 00 00 00 02 80 02
39 01 00 00 00 00 02 81 02
39 01 00 00 00 00 02 82 02
39 01 00 00 00 00 02 83 02
39 01 00 00 00 00 02 84 05
39 01 00 00 00 00 02 85 05
39 01 00 00 00 00 02 86 05
39 01 00 00 00 00 02 87 05
39 01 00 00 00 00 02 88 01
39 01 00 00 00 00 02 89 06
39 01 00 00 00 00 02 8A 07
39 01 00 00 00 00 04 FF 98 81 04
39 01 00 00 00 00 02 3B 80
39 01 00 00 00 00 02 6C 15
39 01 00 00 00 00 02 6E 19
39 01 00 00 00 00 02 6F 25
39 01 00 00 00 00 02 8D 1F
39 01 00 00 00 00 02 87 BA
39 01 00 00 00 00 02 7A 10
39 01 00 00 00 00 02 71 B0
39 01 00 00 00 00 02 0B 80
39 01 00 00 00 00 02 0E 17
39 01 00 00 00 00 04 FF 98 81 01
39 01 00 00 00 00 02 22 09
39 01 00 00 00 00 02 31 00
39 01 00 00 00 00 02 40 33
39 01 00 00 00 00 02 43 66
39 01 00 00 00 00 02 50 97
39 01 00 00 00 00 02 51 92
39 01 00 00 00 00 02 60 15
39 01 00 00 00 00 02 61 01
39 01 00 00 00 00 02 62 0C
39 01 00 00 00 00 02 63 00
39 01 00 00 00 00 02 A0 00
39 01 00 00 00 00 02 A1 0F
39 01 00 00 00 00 02 A2 1C
39 01 00 00 00 00 02 A3 12
39 01 00 00 00 00 02 A4 13
39 01 00 00 00 00 02 A5 25
39 01 00 00 00 00 02 A6 1B
39 01 00 00 00 00 02 A7 1E
39 01 00 00 00 00 02 A8 66
39 01 00 00 00 00 02 A9 1D
39 01 00 00 00 00 02 AA 2A
39 01 00 00 00 00 02 AB 54
39 01 00 00 00 00 02 AC 18
39 01 00 00 00 00 02 AD 16
39 01 00 00 00 00 02 AE 4A
39 01 00 00 00 00 02 AF 1E
39 01 00 00 00 00 02 B0 29
39 01 00 00 00 00 02 B1 4C
39 01 00 00 00 00 02 B2 60
39 01 00 00 00 00 02 B3 3F
39 01 00 00 00 00 02 C0 00
39 01 00 00 00 00 02 C1 0F
39 01 00 00 00 00 02 C2 1C
39 01 00 00 00 00 02 C3 12
39 01 00 00 00 00 02 C4 13
39 01 00 00 00 00 02 C5 25
39 01 00 00 00 00 02 C6 1B
39 01 00 00 00 00 02 C7 1E
39 01 00 00 00 00 02 C8 66
39 01 00 00 00 00 02 C9 1D
39 01 00 00 00 00 02 CA 2A
39 01 00 00 00 00 02 CB 54
39 01 00 00 00 00 02 CC 18
39 01 00 00 00 00 02 CD 16
39 01 00 00 00 00 02 CE 4A
39 01 00 00 00 00 02 CF 1E
39 01 00 00 00 00 02 D0 29
39 01 00 00 00 00 02 D1 4C
39 01 00 00 00 00 02 D2 60
39 01 00 00 00 00 02 D3 3F
39 01 00 00 00 00 04 FF 98 81 02
39 01 00 00 00 00 02 06 40
39 01 00 00 00 00 02 07 03
39 01 00 00 00 00 04 FF 98 81 00
39 01 00 00 00 00 02 35 00
39 01 00 00 00 00 02 36 03
05 01 00 00 78 00 02 11 00
05 01 00 00 32 00 02 29 00
39 01 00 00 00 00 03 68 04 01
39 01 00 00 05 00 03 51 00 00
39 01 00 00 05 00 02 53 24
39 01 00 00 05 00 02 55 01
];

		qcom,mdss-dsi-off-command = [05 01 00 00 32 00 02 28 00
					05 01 00 00 78 00 02 10 00];
		qcom,mdss-dsi-on-command-state = "dsi_lp_mode";
		qcom,mdss-dsi-off-command-state = "dsi_lp_mode";
		qcom,mdss-dsi-lp11-init;
		qcom,mdss-dsi-bl-pmic-control-type = "bl_ctrl_dcs";
		qcom,mdss-dsi-reset-sequence = <1 10>, <0 10>, <1 20>;
		qcom,mdss-pan-physical-width-dimension = <62>;
		qcom,mdss-pan-physical-height-dimension = <110>;

		qcom,mdss-dsi-panel-status-command0 = [06 01 00 01 05 00 02 0A 00];
		qcom,mdss-dsi-panel-status-command-state = "dsi_lp_mode";
/*		qcom,mdss-dsi-panel-status-check-mode = "reg_read";
		qcom,mdss-dsi-panel-status-value0 = <0x9C>;
		qcom,mdss-dsi-panel-status-command1 = [06 01 00 01 05 00 02 0E 00];
		qcom,mdss-dsi-panel-status-value1 = <0x80>;
		qcom,mdss-dsi-panel-status-command2 = [06 01 00 01 05 00 02 0B 00];
		qcom,mdss-dsi-panel-status-value2 = <0x48>;
		qcom,mdss-dsi-panel-status-command3 = [06 01 00 01 05 00 02 0D 00];
		qcom,mdss-dsi-panel-status-value3 = <0x20>;
		qcom,esd-check-enabled;
		zte,lcd-esd-read-reg-num = <2>;
		zte,lcd-esd-interval-time = <5000>;*/
	};
};
