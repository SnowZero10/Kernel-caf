/* Copyright (c) 2013, The Linux Foundation. All rights reserved.
 *
 * This program is free software; you can redistribute it and/or modify
 * it under the terms of the GNU General Public License version 2 and
 * only version 2 as published by the Free Software Foundation.
 *
 * This program is distributed in the hope that it will be useful,
 * but WITHOUT ANY WARRANTY; without even the implied warranty of
 * MERCHANTABILITY or FITNESS FOR A PARTICULAR PURPOSE.  See the
 * GNU General Public License for more details.
 */

/*---------------------------------------------------------------------------
 * This file is autogenerated file using gcdb parser. Please do not edit it.
 * Update input XML file to add a new entry or update variable in this file
 * VERSION = "1.0"
 *---------------------------------------------------------------------------*/
&mdss_mdp {
	dsi_holitech_st7701s_480p_video: qcom,mdss_dsi_holitech_st7701s_480p_video {
		qcom,mdss-dsi-panel-name = "holitech st7701s 480p video mode dsi panel 20180402";
		qcom,cont-splash-enabled;
		qcom,panel-supply-entries = <&dsi_panel_pwr_supply>;
		qcom,mdss-dsi-panel-controller = <&mdss_dsi0>;
		qcom,mdss-dsi-panel-type = "dsi_video_mode";
		qcom,mdss-dsi-panel-destination = "display_1";
		qcom,mdss-dsi-panel-framerate = <60>;
		qcom,mdss-dsi-virtual-channel-id = <0>;
		qcom,mdss-dsi-stream = <0>;
		qcom,mdss-pan-physical-height-dimension = <121>;
		qcom,mdss-pan-physical-width-dimension = <61>;
		qcom,mdss-dsi-panel-width = <480>;
		qcom,mdss-dsi-panel-height = <960>;
		qcom,mdss-dsi-h-front-porch = <60>;
		qcom,mdss-dsi-h-back-porch = <40>;
		qcom,mdss-dsi-h-pulse-width = <12>;
		qcom,mdss-dsi-h-sync-skew = <0>;
		qcom,mdss-dsi-v-back-porch = <12>;
		qcom,mdss-dsi-v-front-porch = <16>;
		qcom,mdss-dsi-v-pulse-width = <4>;
		qcom,mdss-dsi-h-left-border = <0>;
		qcom,mdss-dsi-h-right-border = <0>;
		qcom,mdss-dsi-v-top-border = <0>;
		qcom,mdss-dsi-v-bottom-border = <0>;
		qcom,mdss-dsi-bpp = <24>;
		qcom,mdss-dsi-color-order = "rgb_swap_rgb";
		qcom,mdss-dsi-underflow-color = <0xff>;
		qcom,mdss-dsi-border-color = <0>;
		qcom,mdss-dsi-on-command = [39 01 00 00 20 00 02 11 00
39 01 00 00 00 00 06 ff 77 01 00 00 10
39 01 00 00 00 00 03 c0 77 00
39 01 00 00 00 00 03 c1 0e 02
39 01 00 00 00 00 03 c2 01 02
39 01 00 00 00 00 02 cc 10
39 01 00 00 00 00 02 bb 00
39 01 00 00 00 00 02 bc 01
39 01 00 00 00 00 02 ca 11
39 01 00 00 00 00 11 b0 00 04 0e 0e 15 09 08 0a 09 1d 08 14 0f 0f 12 18
39 01 00 00 00 00 11 b1 00 04 0c 0c 14 09 06 09 08 20 07 16 13 16 1c 18
39 01 00 00 00 00 06 ff 77 01 00 00 11
39 01 00 00 00 00 02 b0 4d
39 01 00 00 00 00 02 b1 40
39 01 00 00 00 00 02 b2 87
39 01 00 00 00 00 02 b3 80
39 01 00 00 00 00 02 b5 49
39 01 00 00 00 00 02 b7 8a
39 01 00 00 00 00 02 b8 21
39 01 00 00 00 00 02 bb 03
39 01 00 00 00 00 02 c1 78
39 01 00 00 00 00 02 c2 78
39 01 00 00 64 00 02 d0 88
39 01 00 00 00 00 04 e0 00 00 02
39 01 00 00 00 00 0c e1 07 8c 09 8c 06 8c 08 8c 00 44 44
39 01 00 00 00 00 0e e2 00 00 00 00 00 00 00 00 00 00 00 00 00
39 01 00 00 00 00 05 e3 00 00 33 33
39 01 00 00 00 00 03 e4 44 44
39 01 00 00 00 00 11 e5 0f ca 8c 8c 11 ca 8c 8c 0b ca 8c 8c 0d ca 8c 8c
39 01 00 00 00 00 05 e6 00 00 33 33
39 01 00 00 00 00 03 e7 44 44
39 01 00 00 00 00 11 e8 0e ca 8c 8c 10 ca 8c 8c 0a ca 8c 8c 0c ca 8c 8c
39 01 00 00 00 00 08 eb 02 01 00 00 00 00 00
39 01 00 00 00 00 11 ed ab 89 76 54 01 ff ff ff ff ff ff 10 45 67 98 ba
39 01 00 00 00 00 06 ff 77 01 00 00 00
39 01 00 00 00 00 06 ff 77 01 00 00 00
39 01 00 00 00 00 02 51 00
39 01 00 00 00 00 02 53 0c
39 01 00 00 00 00 02 55 01
39 01 00 00 0A 00 02 29 00];
		qcom,mdss-dsi-off-command = [39 01 00 00 00 00 02 53 00
					05 01 00 00 32 00 02 28 00
					05 01 00 00 78 00 02 10 00];
		qcom,mdss-dsi-on-command-state = "dsi_lp_mode";
		qcom,mdss-dsi-off-command-state = "dsi_lp_mode";
		qcom,mdss-dsi-h-sync-pulse = <1>;
		qcom,mdss-dsi-traffic-mode = "burst_mode";
		qcom,mdss-dsi-lane-map = "lane_map_0123";
		qcom,mdss-dsi-bllp-eof-power-mode;
		qcom,mdss-dsi-bllp-power-mode;
		qcom,mdss-dsi-lane-0-state;
		qcom,mdss-dsi-lane-1-state;
		qcom,mdss-dsi-panel-timings = [79 1A 12 00 3E 42 16 1E 15 03 04 00];
		qcom,mdss-dsi-t-clk-post = <0x04>;
		qcom,mdss-dsi-t-clk-pre = <0x1A>;
		qcom,mdss-dsi-bl-min-level = <4>;
		qcom,mdss-dsi-bl-max-level = <255>;
		qcom,mdss-dsi-dma-trigger = "trigger_sw";
		qcom,mdss-dsi-mdp-trigger = "none";
		qcom,mdss-dsi-bl-pmic-control-type = "bl_ctrl_dcs";
		qcom,mdss-dsi-reset-sequence = <1 20>, <0 2>, <1 20>;
		qcom,mdss-dsi-lp11-init;
		zte,mdss-dsi-cabc-53h-value = <0x0c>;
	};
};
