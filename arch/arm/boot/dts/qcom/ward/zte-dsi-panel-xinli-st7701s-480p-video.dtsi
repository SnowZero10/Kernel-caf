/* Copyright (c) 2013, The Linux Foundation. All rights reserved.
 *
 * This program is free software; you can redistribute it and/or modify
 * it under the terms of the GNU General Public License version 2 and
 * only version 2 as published by the Free Software Foundation.
 *
 * This program is distributed in the hope that it will be useful,
 * but WITHOUT ANY WARRANTY; without even the implied warranty of
 * MERCHANTABILITY or FITNESS FOR A PARTICULAR PURPOSE.  See the
 * GNU General Public License for more details.
 */

/*---------------------------------------------------------------------------
 * This file is autogenerated file using gcdb parser. Please do not edit it.
 * Update input XML file to add a new entry or update variable in this file
 * VERSION = "1.0"
 *---------------------------------------------------------------------------*/
&mdss_mdp {
	dsi_xinli_st7701s_480p_video: qcom,mdss_dsi_xinli_st7701s_480p_video {
		qcom,mdss-dsi-panel-name = "xinli st7701s 480p video mode dsi panel 20180402";
		qcom,cont-splash-enabled;
		qcom,panel-supply-entries = <&dsi_panel_pwr_supply>;
		qcom,mdss-dsi-panel-controller = <&mdss_dsi0>;
		qcom,mdss-dsi-panel-type = "dsi_video_mode";
		qcom,mdss-dsi-panel-destination = "display_1";
		qcom,mdss-dsi-panel-framerate = <60>;
		qcom,mdss-dsi-virtual-channel-id = <0>;
		qcom,mdss-dsi-stream = <0>;
		qcom,mdss-pan-physical-height-dimension = <121>;
		qcom,mdss-pan-physical-width-dimension = <61>;
		qcom,mdss-dsi-panel-width = <480>;
		qcom,mdss-dsi-panel-height = <960>;
		qcom,mdss-dsi-h-front-porch = <60>;
		qcom,mdss-dsi-h-back-porch = <40>;
		qcom,mdss-dsi-h-pulse-width = <12>;
		qcom,mdss-dsi-h-sync-skew = <0>;
		qcom,mdss-dsi-v-back-porch = <12>;
		qcom,mdss-dsi-v-front-porch = <16>;
		qcom,mdss-dsi-v-pulse-width = <4>;
		qcom,mdss-dsi-h-left-border = <0>;
		qcom,mdss-dsi-h-right-border = <0>;
		qcom,mdss-dsi-v-top-border = <0>;
		qcom,mdss-dsi-v-bottom-border = <0>;
		qcom,mdss-dsi-bpp = <24>;
		qcom,mdss-dsi-color-order = "rgb_swap_rgb";
		qcom,mdss-dsi-underflow-color = <0xff>;
		qcom,mdss-dsi-border-color = <0>;
		qcom,mdss-dsi-on-command = [05 01 00 00 20 00 02 11 00
			39 01 00 00 00 00 06 ff 77 01 00 00 10
			39 01 00 00 00 00 03 c0 77 00
			39 01 00 00 00 00 03 c1 09 02
			39 01 00 00 00 00 03 c2 07 03
			39 01 00 00 00 00 02 cc 10
			39 01 00 00 00 00 02 ca 11
			39 01 00 00 00 00 02 bb 00
			39 01 00 00 00 00 02 bc 01
			39 01 00 00 00 00 11 b0 00 02 0c 0f 16 09 05 09 09 1a 07 14 0f 0d 10 18
			39 01 00 00 00 00 11 b1 00 00 05 0f 12 09 05 08 09 1b 07 15 10 0d 10 18
			39 01 00 00 00 00 06 ff 77 01 00 00 11
			39 01 00 00 00 00 02 b0 4d
			39 01 00 00 00 00 02 b1 38
			39 01 00 00 00 00 02 b2 07
			39 01 00 00 00 00 02 b3 80
			39 01 00 00 00 00 02 b5 47
			39 01 00 00 00 00 02 b7 85
			39 01 00 00 00 00 02 b8 10
			39 01 00 00 00 00 02 b9 10
			39 01 00 00 00 00 02 c1 78
			39 01 00 00 00 00 02 c2 78
			39 01 00 00 64 00 02 d0 88
			39 01 00 00 00 00 06 ff 77 01 00 00 11
			39 01 00 00 00 00 04 e0 00 00 02
			39 01 00 00 00 00 0c e1 02 91 00 00 01 91 00 00 00 60 60
			39 01 00 00 00 00 0e e2 30 30 40 40 c9 91 00 00 c8 91 00 00 00
			39 01 00 00 00 00 05 e3 00 00 33 33
			39 01 00 00 00 00 03 e4 44 44
			39 01 00 00 00 00 11 e5 06 ca 4b 91 08 cc 4b 91 0a ce 4b 91 0c d0 4b 91
			39 01 00 00 00 00 05 e6 00 00 33 33
			39 01 00 00 00 00 03 e7 44 44
			39 01 00 00 00 00 11 e8 05 c9 4b 91 07 cb 4b 91 09 cd 4b 91 0b cf 4b 91
			39 01 00 00 00 00 08 eb 02 01 e4 e4 88 00 00
			39 01 00 00 00 00 03 ec 00 00
			39 01 00 00 00 00 11 ed fa b0 2f f4 65 7f ff ff ff ff f7 56 4f f2 0b af
			39 01 00 00 00 00 06 ff 77 01 00 00 00
			39 01 00 00 00 00 02 51 00
			39 01 00 00 00 00 02 53 0c
			39 01 00 00 00 00 02 55 01
			05 01 00 00 20 00 02 29 00 ];
		qcom,mdss-dsi-off-command = [39 01 00 00 00 00 02 53 00
					05 01 00 00 32 00 02 28 00
					05 01 00 00 78 00 02 10 00];
		qcom,mdss-dsi-on-command-state = "dsi_lp_mode";
		qcom,mdss-dsi-off-command-state = "dsi_lp_mode";
		qcom,mdss-dsi-h-sync-pulse = <1>;
		qcom,mdss-dsi-traffic-mode = "burst_mode";
		qcom,mdss-dsi-lane-map = "lane_map_0123";
		qcom,mdss-dsi-bllp-eof-power-mode;
		qcom,mdss-dsi-bllp-power-mode;
		qcom,mdss-dsi-lane-0-state;
		qcom,mdss-dsi-lane-1-state;
		qcom,mdss-dsi-panel-timings = [79 1A 12 00 3E 42 16 1E 15 03 04 00];
		qcom,mdss-dsi-t-clk-post = <0x04>;
		qcom,mdss-dsi-t-clk-pre = <0x1A>;
		qcom,mdss-dsi-bl-min-level = <4>;
		qcom,mdss-dsi-bl-max-level = <255>;
		qcom,mdss-dsi-dma-trigger = "trigger_sw";
		qcom,mdss-dsi-mdp-trigger = "none";
		qcom,mdss-dsi-bl-pmic-control-type = "bl_ctrl_dcs";
		qcom,mdss-dsi-reset-sequence = <1 20>, <0 2>, <1 20>;
		qcom,mdss-dsi-lp11-init;
		zte,mdss-dsi-cabc-53h-value = <0x0c>;
	};
};
